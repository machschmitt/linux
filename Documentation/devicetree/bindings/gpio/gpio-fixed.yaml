## Documentation/devicetree/bindings/gpio/gpio-fixed.yaml
```yaml
# SPDX-License-Identifier: (GPL-2.0 OR BSD-2-Clause)
%YAML 1.2
---
$id: http://devicetree.org/schemas/gpio/gpio-fixed.yaml#
$schema: http://devicetree.org/meta-schemas/core.yaml#

title: Fixed state GPIO controller

maintainers:
  - Marcelo Schmitt <marcelo.schmitt@analog.com>

description:
  Any property defined as part of the core regulator binding, defined in
  regulator.yaml, can also be used. However a fixed voltage regulator is
  expected to have the regulator-min-microvolt and regulator-max-microvolt
  to be the same.

properties:
  compatible:
    items:
      - const: fixed-gpios

  reg:
    maxItems: 1

  "#gpio-cells":
    const: 2

  gpio-controller: true

  gpio-line-names: true

  gpio-ranges:
    minItems: 1
    maxItems: 8

required:
  - compatible
  - reg
  - "#gpio-cells"
  - gpio-controller

additionalProperties: false

examples:
  - |
    gpio-fixed {
        #gpio-cells = <2>;
        pinctrl-names = "default";
        pinctrl-0 = <&pinctrl_di_do_leds>;
        compatible = "fixed-gpios";
        gpio-controller;

        latched-gpios = <&gpio3 21 0>, <&gpio3 22 0>,
                       <&gpio3 23 0>, <&gpio3 24 0>,
                       <&gpio3 25 0>, <&gpio3 26 0>,
                       <&gpio3 27 0>, <&gpio3 28 0>;
    };
```

## Documentation/devicetree/bindings/iio/adc/adi,ad4134.yaml
```yaml
# SPDX-License-Identifier: (GPL-2.0-only OR BSD-2-Clause)
%YAML 1.2
---
$id: http://devicetree.org/schemas/iio/adc/adi,ad4134.yaml#
$schema: http://devicetree.org/meta-schemas/core.yaml#

title: Analog Devices AD4134 ADC

maintainers:
  - Cosmin Tanislav <cosmin.tanislav@analog.com>

description: |
  The AD4134 is a quad channel, low noise, simultaneous sampling,
  precision analog-to-digital converter (ADC) that delivers on
  functionality, performance, and ease of use.

    https://www.analog.com/en/products/ad4134.html

properties:
  compatible:
    oneOf:
      - const: adi,ad4134
      - items:
          - enum:
              - adi,ad7134
          - const: adi,ad4134

  reg:
    maxItems: 1

  spi-max-frequency:
    maximum: 1000000

  reset-gpios:
    maxItems: 1

  clocks:
    maxItems: 1

  clock-names:
    items:
      - const: sys_clk

  avdd5-supply:
    description: A 5V supply that powers the chip's analog circuitry.

  dvdd5-supply:
    description: A 5V supply that powers the chip's digital circuitry.

  iovdd-supply:
    description:
      A 1.8V supply that sets the logic levels for the digital interface pins.

  avdd1v8-supply:
    description: A 1.8V supply used by the analog circuitry.

  dvdd1v8-supply:
    description: A 1.8V supply used by the digital circuitry.

  clkvdd-supply:
    description: A 1.8V supply for the chip's clock management circuit.

  ldoin-supply:
    description:
      A 2.6V to 5.5V supply that generates 1.8V for AVDD1V8, DVDD1V8, and CLKVDD
      pins.

  refin-supply:
    description:
      Additional supply used to reduce the noise contribution of the reference
      source to the overall ADC conversion accuracy.

  odr-gpios:
    description:
      GPIO connected to ODR pin. Used to sample ADC data in minimum I/O mode.
    maxItems: 1

  adi,adc-frame:
    $ref: /schemas/types.yaml#/definitions/string
    enum: [ 16-bit, 16-bit+CRC, 24-bit, 24-bit+CRC ]
    default: 24-bit
    description:
      Describes how the ADC data packet should be configured. The data packet
      size is 16-bit when "16-bit" is selected, 24-bit when "16-bit+CRC" or
      "24-bit" are selected, and 32-bit when "24-bit+CRC" is set.

  adi,spi-engine:
    $ref: /schemas/types.yaml#/definitions/phandle
    description: phandle of the SPI slave connected to the SPI engine master

required:
  - compatible
  - reg
  - clocks
  - clock-names
  - refin-supply
  - adi,spi-engine

additionalProperties: false

examples:
  - |
    #include <dt-bindings/gpio/gpio.h>

    spi {
      #address-cells = <1>;
      #size-cells = <0>;

      adc@0 {
        compatible = "adi,ad4134";
        reg = <0>;

        spi-max-frequency = <1000000>;

        reset-gpios = <&gpio0 86 GPIO_ACTIVE_LOW>;

        clocks = <&sys_clk>;
        clock-names = "sys_clk";

        avdd5-supply = <&avdd5>;
        avdd1v8-supply = <&avdd1v8>;
        iovdd-supply = <&iovdd>;
        refin-supply = <&refin>;

        adi,adc-frame = "24-bit";
        adi,spi-engine = <&ad4134_spi_engine>;
      };
    };
...
```

## Documentation/devicetree/bindings/iio/adc/adi,ada4355.yaml
```yaml
# SPDX-License-Identifier: (GPL-2.0-only OR BSD-2-Clause)
%YAML 1.2
---
$id: http://devicetree.org/schemas/iio/adc/adi,ada4355.yaml#
$schema: http://devicetree.org/meta-schemas/core.yaml#

title: Analog Devices Transimpedance Current to Bits Receiver

maintainers:
  - Marcelo Schmitt <marcelo.schmitt@analog.com>

description: |
  ADA4355 programmable transimpedance, current to bits receiver and similar data
  converters.
  Specifications can be found at:
    https://www.analog.com/media/en/technical-documentation/data-sheets/ada4355.pdf
    https://www.analog.com/media/en/technical-documentation/data-sheets/ada4356.pdf

$ref: /schemas/spi/spi-peripheral-props.yaml#

properties:
  compatible:
    enum:
      - adi,ada4355
      - adi,ada4356

  reg:
    maxItems: 1

  spi-max-frequency:
    maximum: 50000000

  vcc-supply:
    description: 3.3V power supply.

  vea-supply:
    description: 1.8V analog power supply to ADC.

  ved-supply:
    description: 1.8V digital power supply to ADC.

  clocks:
    maxItems: 1

  vld-en-gpios:
    description: VLD Output Enable.

  io-backends:
    description:
      The AXI ADC IP block connected to the D+/- and DCO+/- lines of the
      ADC. An example backend can be found at
      http://analogdevicesinc.github.io/hdl/projects/pulsar_lvds/index.html.
    maxItems: 1

required:
  - compatible
  - reg
  - vcc-supply

unevaluatedProperties: false

examples:
  - |
    #include <dt-bindings/gpio/gpio.h>
    spi {
        #address-cells = <1>;
        #size-cells = <0>;

        adc@0 {
            compatible = "adi,ada4355";
            reg = <0>;
            spi-max-frequency = <100000>;
            spi-cpol;
            spi-cpha;
            vcc-supply = <&supply_3_3V>;
            clocks = <&ref_clk>;
            clock-names = "adc_clk";
            vld-en-gpios = <&gpio0 89 GPIO_ACTIVE_HIGH>;
            io-backends = <&axi_adc>;
        };
    };
```

## Documentation/devicetree/bindings/iio/dac/adi,ad9740.yaml
```yaml
# SPDX-License-Identifier: (GPL-2.0-only OR BSD-2-Clause)
%YAML 1.2
---
$id: http://devicetree.org/schemas/iio/dac/adi,ad9740.yaml#
$schema: http://devicetree.org/meta-schemas/core.yaml#

title: Analog Devices AD9740 family of TxDAC digital to analog converters

maintainers:
  - Marcelo Schmitt <marcelo.schmitt@analog.com>
  - Sergiu Arpadi <sergiu.arpadi@analog.com>

description: |
  The AD9740 family are single supply, 210 MSPS current output digital to
  analog converters differing only in resolution. Data is clocked into the
  device over a parallel CMOS interface, so the devices rely on an IIO
  backend (typically the AXI DAC IP core) to stream samples from memory.

    AD9748 -  8-bit
    AD9740 - 10-bit
    AD9742 - 12-bit
    AD9744 - 14-bit

  https://www.analog.com/media/en/technical-documentation/data-sheets/AD9740.pdf
  https://www.analog.com/media/en/technical-documentation/data-sheets/AD9742.pdf
  https://www.analog.com/media/en/technical-documentation/data-sheets/AD9744.pdf
  https://www.analog.com/media/en/technical-documentation/data-sheets/AD9748.pdf

properties:
  compatible:
    enum:
      - adi,ad9740
      - adi,ad9742
      - adi,ad9744
      - adi,ad9748

  reg:
    maxItems: 1

  io-backends:
    maxItems: 1

  reset-gpios:
    maxItems: 1

  adi,twos-complement:
    description:
      Configure the backend to feed the device with two's complement data
      instead of the default offset binary (straight unsigned) encoding.
    type: boolean

required:
  - compatible
  - reg
  - io-backends

additionalProperties: false

examples:
  - |
    #include <dt-bindings/gpio/gpio.h>

    axi_dac: dac@44a70000 {
        compatible = "adi,axi-ad9740";
        reg = <0x44a70000 0x1000>;
        dmas = <&dac_tx_dma 0>;
        dma-names = "tx";
        clocks = <&clkc 15>, <&dac_clk>;
        clock-names = "s_axi_aclk", "dac_clk";
        #io-backend-cells = <0>;

        #address-cells = <1>;
        #size-cells = <0>;

        dac@0 {
            compatible = "adi,ad9740";
            reg = <0>;
            io-backends = <&axi_dac>;
            reset-gpios = <&gpio0 92 GPIO_ACTIVE_LOW>;
        };
    };
...
```
