## Documentation/devicetree/bindings/iio/adc/adi,ad4000.yaml
```yaml
# SPDX-License-Identifier: (GPL-2.0-only OR BSD-2-Clause)
%YAML 1.2
---
$id: http://devicetree.org/schemas/iio/adc/adi,ad4000.yaml#
$schema: http://devicetree.org/meta-schemas/core.yaml#

title: Analog Devices AD4000 ADC device driver

maintainers:
  - Marcelo Schmitt <marcelo.schmitt@analog.com>

description: |
  Analog Devices AD4000 family of Analog to Digital Converters with SPI support.
  Specifications can be found at:
    https://www.analog.com/media/en/technical-documentation/data-sheets/ad4000-4004-4008.pdf
    https://www.analog.com/media/en/technical-documentation/data-sheets/ad4001-4005.pdf
    https://www.analog.com/media/en/technical-documentation/data-sheets/ad4002-4006-4010.pdf
    https://www.analog.com/media/en/technical-documentation/data-sheets/ad4003-4007-4011.pdf
    https://www.analog.com/media/en/technical-documentation/data-sheets/ad4020-4021-4022.pdf
    https://www.analog.com/media/en/technical-documentation/data-sheets/adaq4003.pdf

properties:
  compatible:
    enum:
      - adi,ad4000
      - adi,ad4001
      - adi,ad4002
      - adi,ad4003
      - adi,ad4004
      - adi,ad4005
      - adi,ad4006
      - adi,ad4007
      - adi,ad4008
      - adi,ad4010
      - adi,ad4011
      - adi,ad4020
      - adi,ad4021
      - adi,ad4022
      - adi,adaq4003

  reg: true
  spi-max-frequency: true

  vref-supply:
    description: Phandle to the regulator for ADC reference voltage.

  adi,gain-milli:
    description: |
      The hardware gain applied to the ADC input (in milli units).
      The gain provided by the ADC input scaler is defined by the hardware
      connections between chip pins OUT+, R1K-, R1K1-, R1K+, R1K1+, and OUT-.
      If not present, default to 1000 (no actual gain applied).
    $ref: /schemas/types.yaml#/definitions/uint32
    enum: [454, 909, 1000, 1900]
    default: 1000

  adi,spi-cs-mode:
    type: boolean
    description: |
      This property indicates the SPI wiring configuration.

      When this property is omitted, it indicates that the device SDI pin is
      connected to SPI controller CS line and device CNV pin has been connected
      to a GPIO. Datasheets call this "4-wire mode".

      When this property is present, the driver must assume standard SPI
      connections which, for these devices, consists of connecting the
      controller CS line to device CNV pin. This configuration is
      (misleadingly) called "3-wire mode" in datasheets.

  cnv-gpios:
    description: Active high GPIO connected to the CNV pin.
    maxItems: 1

patternProperties:
  "^channel@([0-1])$":
    $ref: adc.yaml
    type: object
    description: Represents the external channel connected to the ADC.

    properties:
      reg:
        maxItems: 1

      diff-channels: true

    required:
      - reg

    additionalProperties: false

required:
  - compatible
  - reg
  - vref-supply

allOf:
  - $ref: /schemas/spi/spi-peripheral-props.yaml#

unevaluatedProperties: false

examples:
  - |
    spi {
        #address-cells = <1>;
        #size-cells = <0>;
        /* Example for a AD4000 devices */
        adc@0 {
            compatible = "adi,ad4020";
            reg = <0>;
            spi-max-frequency = <71000000>;
            vref-supply = <&vref>;
            #address-cells = <1>;
            #size-cells = <0>;
            channel@0 {
                reg = <0>;
                diff-channels = <0 1>;
            };
        };
    };
  - |
    #include <dt-bindings/gpio/gpio.h>
    spi {
        #address-cells = <1>;
        #size-cells = <0>;
        /* Example for a ADAQ4000 devices */
        adc@0 {
            compatible = "adi,adaq4003";
            reg = <0>;
            spi-max-frequency = <80000000>;
            vref-supply = <&vref>;
            cnv-gpios = <&gpio0 88 GPIO_ACTIVE_HIGH>;
            adi,spi-cs-mode;
            adi,gain-milli = <454>;
            #address-cells = <1>;
            #size-cells = <0>;
            channel@0 {
                reg = <0>;
                diff-channels = <0 1>;
            };
        };
    };
```

## Documentation/devicetree/bindings/iio/adc/adi,ad7091r8.yaml
```yaml
# SPDX-License-Identifier: GPL-2.0-only OR BSD-2-Clause
%YAML 1.2
---
$id: http://devicetree.org/schemas/iio/adc/adi,ad7091r8.yaml#
$schema: http://devicetree.org/meta-schemas/core.yaml#

title: Analog Devices AD7091R8 8-Channel 12-Bit ADC

maintainers:
  - Marcelo Schmitt <marcelo.schmitt@analog.com>

description: |
  Analog Devices AD7091R-8 8-Channel 12-Bit ADC
  https://www.analog.com/media/en/technical-documentation/data-sheets/AD7091R-2_7091R-4_7091R-8.pdf

properties:
  compatible:
    enum:
      - adi,ad7091r2
      - adi,ad7091r4
      - adi,ad7091r8

  reg:
    maxItems: 1

  vref-supply:
    description:
      Phandle to the vref power supply

  spi-max-frequency: true

required:
  - compatible
  - reg

additionalProperties: false

examples:
  - |
    spi {
        #address-cells = <1>;
        #size-cells = <0>;

        ad7091r8: adc@0 {
                compatible = "adi,ad7091r8";
                reg = <0x0>;
                spi-max-frequency = <45454545>;
                vref-supply = <&adc_vref>;
        };
    };
...
```

## Documentation/devicetree/bindings/iio/frequency/adi,axi-dds.yaml
```yaml
# SPDX-License-Identifier: (GPL-2.0-only OR BSD-2-Clause)
%YAML 1.2
---
$id: http://devicetree.org/schemas/iio/frequency/adi,axi-dds.yaml#
$schema: http://devicetree.org/meta-schemas/core.yaml#

title: Analog Devices AXI DAC IP core

maintainers:
  - Marcelo Schmitt <marcelo.schmitt@analog.com>

description: |
  Analog Devices Generic AXI DAC IP core for interfacing a DAC device
  with a high speed serial (JESD204B/C) or source synchronous parallel
  interface (LVDS/CMOS).
  Usually, some other interface type (i.e SPI) is used as a control
  interface for the actual DAC, while this IP core will interface
  to the data-lines of the DAC and handle the streaming of data from memory to
  DAC via DMA.

  https://wiki.analog.com/resources/fpga/docs/axi_dac_ip

properties:
  compatible:
    enum:
      - adi,axi-dac-10.0.a

  reg:
    maxItems: 1

  dmas:
    maxItems: 1

  dma-names:
    items:
      - const: tx

  adi,axi-dds-default-frequency:
    description:
      Output signal frequency when the DDS core is enabled.

  adi,axi-dds-default-scale:
    description:
      Output signal scale when the DDS core is enabled.

  adi,dac-dev:
    $ref: /schemas/types.yaml#/definitions/phandle
    description:
      A reference to a the actual DAC to which this FPGA DDS interfaces to.
    deprecated: true

  '#io-backend-cells':
    const: 0

required:
  - compatible
  - dmas
  - reg

additionalProperties: false

examples:
  - |
    axi-dac@44a30000 {
        compatible = "adi,axi-dac-10.0.a";
        reg = <0x44a30000 0x10000>;
        dmas = <&rx_dma 0>;
        dma-names = "tx";
        adi,axi-dds-default-frequency = <1000000>;
        adi,axi-dds-default-scale = <0x800>;
        #io-backend-cells = <0>;
    };
...
```

## Documentation/devicetree/bindings/iio/temperature/maxim,max30208.yaml
```yaml
# SPDX-License-Identifier: (GPL-2.0 OR BSD-2-Clause)
%YAML 1.2
---
$id: http://devicetree.org/schemas/iio/temperature/maxim,max30208.yaml#
$schema: http://devicetree.org/meta-schemas/core.yaml#

title: Maxim MAX30208/MAX30210 Digital Temperature Sensor

maintainers:
  - Marcelo Schmitt <marcelo.schmitt@analog.com>

description: |
  https://www.analog.com/media/en/technical-documentation/data-sheets/MAX30208.pdf
  https://www.analog.com/media/en/technical-documentation/data-sheets/max30210.pdf

properties:
  compatible:
    enum:
      - maxim,max30208
      - maxim,max30210

  reg:
    maxItems: 1

additionalProperties: false

required:
  - compatible
  - reg

examples:
  - |
    i2c {
        #address-cells = <1>;
        #size-cells = <0>;

        temp-sensor@50 {
            compatible = "maxim,max30208";
            reg = <0x50>;
        };
    };
...
```
